## test/tests/core/libc/Kconfig
```kconfig
menu "libc"

config TEST_CORE_LIBC_ALL
    bool "Select all"
    default n
    select TEST_CORE_LIBC_STRING
    select TEST_CORE_LIBC_RANDOM_LCG
    select TEST_CORE_LIBC_SYMBOL

config TEST_CORE_LIBC_STRING
    bool "string.c"
    default n

config TEST_CORE_LIBC_RANDOM_LCG
    bool "random-lcg.c"
    default n

config TEST_CORE_LIBC_SYMBOL
    bool "symbol.c"
    default n

endmenu
```

## test/tests/core/mm/Kconfig
```kconfig
menu "Memory manager"

config TEST_CORE_MM_ALL
    bool "Select all"
    default n
    select TEST_CORE_MM_FREELIST
    select TEST_CORE_MM_BITSET_SLAB

config TEST_CORE_MM_FREELIST
    bool "freelist.c"
    default n

config TEST_CORE_MM_BITSET_SLAB
    bool "bitset-slab.c"
    default n

endmenu
```

## test/tests/core/process/Kconfig
```kconfig
menu "Process"

config TEST_CORE_PROCESS_ALL
    bool "Select all"
    default n
    select TEST_CORE_PROCESS_CORE

config TEST_CORE_PROCESS_CORE
    bool "core.c"
    default n

endmenu
```

## test/tests/core/property/Kconfig
```kconfig
menu "Property"

config TEST_CORE_PROPERTY_ALL
    bool "Select all"
    default n
    select TEST_CORE_PROPERTY_CORE

config TEST_CORE_PROPERTY_CORE
    bool "core.c"
    default n

endmenu
```

## test/tests/core/sync/Kconfig
```kconfig
menu "Synchronization"

config TEST_CORE_SYNC_ALL
    bool "Select all"
    default n
    select TEST_CORE_SYNC_SEMAPHORE
    select TEST_CORE_SYNC_ATOMIC
    select TEST_CORE_SYNC_RMUTEX

config TEST_CORE_SYNC_SEMAPHORE
    bool "semaphore.c"
    default n

config TEST_CORE_SYNC_RMUTEX
    bool "rmutex.c"
    default n

config TEST_CORE_SYNC_ATOMIC
    bool "atomic.c"
    default n

endmenu
```

## test/tests/core/time/Kconfig
```kconfig
menu "Time"

config TEST_CORE_TIME_ALL
    bool "Select all"
    default n
    select TEST_CORE_TIME_TIME

config TEST_CORE_TIME_TIME
    bool "time.c"
    default n

endmenu
```

## test/tests/core/utils/Kconfig
```kconfig
menu "Utils"

config TEST_CORE_UTILS_ALL
    bool "Select all"
    default n
    select TEST_CORE_UTILS_MATH
    select TEST_CORE_UTILS_LATENCY
    select TEST_CORE_UTILS_RANDOM_LCG
    select TEST_CORE_UTILS_SYMBOL

config TEST_CORE_UTILS_MATH
    bool "math.c"
    default n

config TEST_CORE_UTILS_LATENCY
    bool "latency.c"
    default n

config TEST_CORE_UTILS_RANDOM_LCG
    bool "random-lcg.c"
    default n

config TEST_CORE_UTILS_SYMBOL
    bool "symbol.c"
    default n

endmenu
```

## test/tests/core/vfs/Kconfig
```kconfig
menu "VFS"

config TEST_CORE_VFS_ALL
    bool "Select all"
    default n
    select TEST_CORE_VFS_CORE

config TEST_CORE_VFS_CORE
    bool "core.c"
    default n

endmenu
```

## test/tests/utils/Kconfig
```kconfig
menu "Utils"

config TEST_UTILS_ALL
    bool "Select all"
    default n
    select TEST_UTILS_MATH
    select TEST_UTILS_LATENCY

config TEST_UTILS_MATH
    bool "math.c"
    default n

config TEST_UTILS_LATENCY
    bool "latency.c"
    default n

endmenu
```
