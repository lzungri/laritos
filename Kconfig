## Kconfig
```kconfig
mainmenu "laritOS/$(ARCH) $(KERNELVERSION) Configuration"

source "scripts/Kconfig.include"

menu "General"

menu "Logging"

menu "Log level"

config LOG_LEVEL_ERROR
    bool "ERROR"
    default y

config LOG_LEVEL_WARN
    bool "WARN"
    default y
    select LOG_LEVEL_ERROR

config LOG_LEVEL_INFO
    bool "INFO"
    default y
    select LOG_LEVEL_WARN

config LOG_LEVEL_DEBUG
    bool "DEBUG"
    select LOG_LEVEL_INFO

config LOG_LEVEL_VERBOSE
    bool "VERBOSE"
    select LOG_LEVEL_DEBUG

endmenu

config LOG_MAX_LINE_SIZE
    int "Max number of character per log line (longer messages will be truncated)"
    default 128

config LOG_BUFSIZE_BYTES
    int "Log buffer size in bytes"
    default 2048

config LOG_FILE_AND_LINEN
    bool "Log file path and line number"
    default n

config LOG_USE_COLORS
    bool "Enable log coloring"
    default y

endmenu

menu "Debugging"

config DEBUG_INFO
    bool "Add debugging info"
    default y

endmenu

menu "Benchmarking"

config BENCHM_STACK_USAGE
    bool "Output stack usage info on a per-function basis"
    default n

endmenu

menu "Compiler"

config CC_DISABLE_OPTIMIZATIONS
    bool "Disable optimizations"
    default y

config CC_USE_SHORT_WCHAR
    bool "Use short unsigned int as wchar_t"
    default n

config CC_OPTIMIZE_FOR_SIZE
    bool "Optimize for size"
    default n

endmenu

endmenu

source "board/Kconfig"
source "arch/Kconfig"
source "core/Kconfig"
source "drivers/Kconfig"
```

## arch/Kconfig
```kconfig
choice
    prompt "Architecture select"
    default ARM

config ARM
    bool "ARM architecture"

config AARCH64
    bool "AARCH64 architecture"

endchoice

choice
    prompt "Instruction set"
    optional

config ARMV7_A
    bool "armv7-a"

config ARMV8_A
    bool "armv8-a"
    
endchoice

source "arch/arm/Kconfig"
source "arch/aarch64/Kconfig"
```

## arch/aarch64/Kconfig
```kconfig
menu "AARCH64 architecture"
    depends on AARCH64

choice
    prompt "CPU selection"
    default SYS_CPU_CORTEX_A57

config SYS_CPU_CORTEX_A57
    bool "cortex-a57"
    select ARMV8_A

endchoice

endmenu
```

## arch/arm/Kconfig
```kconfig
menu "ARM architecture"
	depends on ARM

choice
    prompt "CPU selection"
    default SYS_CPU_CORTEX_A15

config SYS_CPU_CORTEX_A15
    bool "cortex-a15"
    select ARMV7_A

config SYS_CPU_CORTEX_A9
    bool "cortex-a9"
    select ARMV7_A

config SYS_CPU_GENERIC_ARMV7A
    bool "generic-armv7a"
    select ARMV7_A

endchoice

source "arch/arm/cpu/Kconfig"

endmenu
```

## arch/arm/cpu/armv7-a/Kconfig
```kconfig
menu "armv-7a options"
    depends on ARMV7_A

config MEM_STACK_SIZE_PER_MODE
    int "Stack size per processor mode (in bytes)"
    default 4194304   # 4 MB

endmenu
```

## board/Kconfig
```kconfig
menu "Board"

config BOARD_MAX_COMPONENT_ATTRS
    int "Max number of attributes per component in the board info (*.bi)"
    default 10

config BOARD_MAX_NAME_LEN_BYTES
    int "Maximum length for board properties ids/names (in bytes)"
    default 32

config BOARD_MAX_VALUE_LEN_BYTES
    int "Maximum length for board property values (in bytes)"
    default 64

config BOARD_QEMU_ARM_VIRT
    bool "QEMU ARM Board"
    depends on ARM

config BOARD_QEMU_AARCH64_VIRT
    bool "QEMU AARCH64 Board"
    depends on AARCH64

source "board/qemu-arm-virt/Kconfig"
source "board/qemu-aarch64-virt/Kconfig"

endmenu
```

## board/configs/qemu_aarch64_virt_defconfig
```kconfig
CONFIG_SYS_BOARD="qemu-aarch64-virt"
CONFIG_BOARD_QEMU_AARCH64_VIRT=y
CONFIG_AARCH64=y
CONFIG_SYS_CPU_CORTEX_A15=y

CONFIG_SYS_FLASH_BASE=0x00000000
CONFIG_SYS_FLASH_SIZE=0x1000000000
CONFIG_SYS_RAM_BASE=0x40000000
CONFIG_SYS_RAM_SIZE=0x40000000
```

## board/configs/qemu_arm_virt_defconfig
```kconfig
CONFIG_SYS_BOARD="qemu-arm-virt"
CONFIG_BOARD_QEMU_ARM_VIRT=y
CONFIG_ARM=y
CONFIG_ARMV7_A=y
CONFIG_CPU_32_BITS=y
CONFIG_SYS_CPU_CORTEX_A15=y
CONFIG_CPU_LITTLE_ENDIAN=y

CONFIG_SMP=y
CONFIG_CPU_MAX_CPUS=4

# From qemu/hw/arm/virt.c
# static const MemMapEntry base_memmap[] = {
#     /* Space up to 0x8000000 is reserved for a boot ROM */
#     [VIRT_FLASH] =              {          0, 0x08000000 },
#     ...
#     [VIRT_PCIE_ECAM] =          { 0x3f000000, 0x01000000 },
#     /* Actual RAM size depends on initial RAM and device memory settings */
#     [VIRT_MEM] =                { GiB, LEGACY_RAMLIMIT_BYTES },
# };
CONFIG_SYS_FLASH_BASE=0x00000000
# Flash size = 128MB
CONFIG_SYS_FLASH_SIZE=0x08000000
CONFIG_SYS_RAM_BASE=0x40000000
# RAM size = 1GB
CONFIG_SYS_RAM_SIZE=0x40000000

# The QEMU arm virtual board is based on the Versatile Express, which requires
# an image of 64MB (see qemu/hw/arm/virt.c#virt_flash_map())
CONFIG_OSIMAGE_FILESIZE=64

CONFIG_INTC_ARM_GICV2=y
CONFIG_UART_ARM_PL011=y
CONFIG_RTC_ARM_PL031=y
CONFIG_TIMER_ARM_V7_GENERIC=y
CONFIG_BLOCKDEV_FLASH_CFI=y

# The QEMU arm virtual board maps two flash memories (see qemu/hw/arm/virt.c#virt_flash_map()):
#   pflash0: base=0x00000000 size=0x04000000
#   pflash1: base=0x04000000 size=0x04000000
# We use pflash0 for the kernel image and pflash1 for the system image
CONFIG_FS_SYSTEM_IMAGE_BASE=0x04000000
# This is the file system size (in MBs), not the flash
CONFIG_FS_SYSTEM_IMAGE_SIZE=10
CONFIG_FS_SYSTEM_IMAGE_TYPE="ext2"

# Data partition size
CONFIG_FS_DATA_IMAGE_SIZE=32
CONFIG_FS_DATA_IMAGE_TYPE="ext2"
```

## board/qemu-aarch64-virt/Kconfig
```kconfig
menu "QEMU AARCH64 Board Options"
    depends on BOARD_QEMU_AARCH64_VIRT

config SYS_BOARD
    string "Board name"
    default "qemu-aarch64-virt"

config SYS_BOARD_INFO_FILE
    string "Board info file"
    default "default.bi"

config SYS_VENDOR
    string "Vendor name"
    default "qemu"

config SYS_FLASH_BASE
    hex "Flash base address"
    default 0x00000000

config SYS_FLASH_SIZE
    hex "Flash size"
    default 0x1000000000

config SYS_RAM_BASE
    hex "RAM base address"
    default 0x40000000

config SYS_RAM_SIZE
    hex "RAM size"
    default 0x40000000

endmenu
```

## board/qemu-arm-virt/Kconfig
```kconfig
menu "QEMU ARM Board Options"
    depends on BOARD_QEMU_ARM_VIRT

config SYS_BOARD
    string "Board name"
    default "qemu-arm-virt"

config SYS_BOARD_INFO_FILE
    string "Board info file"
    default "default.bi"

config SYS_VENDOR
    string "Vendor name"
    default "qemu"

config SYS_FLASH_BASE
    hex "Flash base address"
    default 0x00000000

config SYS_FLASH_SIZE
    hex "Flash size"
    default 0x1000000000

config SYS_RAM_BASE
    hex "RAM base address"
    default 0x40000000

config SYS_RAM_SIZE
    hex "RAM size"
    default 0x40000000

config OSIMAGE_FILESIZE
    int "laritos.img size (in MB)"
    default 64

endmenu
```

## core/Kconfig
```kconfig
menu "Kernel"

source "core/component/Kconfig"
source "core/syscall/Kconfig"
source "core/libc/Kconfig"
source "core/mm/Kconfig"
source "core/loader/Kconfig"
source "core/process/Kconfig"
source "core/sched/Kconfig"
source "core/irq/Kconfig"
source "core/sync/Kconfig"
source "core/board/Kconfig"

menu "Symmetric multiprocessing"

config SMP
    bool "Symmetric multiprocessing enabled"
    default n

config CPU_MAX_CPUS
    int "Maximum number of supported cpus"
    default 4

endmenu

endmenu
```

## core/board/Kconfig
```kconfig
menu "Board"

config BOARD_MAX_COMPONENTS
    int "Max number of components in the board info (*.bi)"
    default 32

config BOARD_MAX_COMPONENT_ATTRS
    int "Max number of attributes per component in the board info (*.bi)"
    default 10

config BOARD_INFO_MAX_TOKEN_LEN_BYTES
    int "Maximum length in bytes for board properties names/ids/values (includes '\0')"
    default 32

endmenu
```

## core/component/Kconfig
```kconfig
menu "Components"

config COMP_INFO_SIZE
    int "Max size for each component info field"
    default 32

menu "Ticker"

config TICKER_DEF_FREQ
    int "Default ticker frequency"
    default 100

endmenu

endmenu
```

## core/fs/Kconfig
```kconfig
menu "File system"

config FS_MAX_FILENAME_LEN
    int "Maximum file name length"
    default 255

config FS_SYSTEM_IMAGE_BASE
    hex "Base address in the flash memory at which the system image is located"
    default 0x04000000

config FS_SYSTEM_IMAGE_SIZE
    int "Size of the system image (in MBs)"
    default 10

config FS_SYSTEM_IMAGE_TYPE
    string "System image filesystem type"
    default ext2

config FS_DATA_IMAGE_SIZE
    int "Size of the data image (in MBs)"
    default 32

config FS_DATA_IMAGE_TYPE
    string "Data image filesystem type"
    default ext2

config FS_KINFO_IMAGE_SIZE
    int "Size of the kinfo image (in MBs)"
    default 4

config FS_KINFO_IMAGE_TYPE
    string "kinfo image filesystem type"
    default ext2

endmenu
```

## core/irq/Kconfig
```kconfig
menu "Interrupts"

config INT_MAX_IRQS
    int "Max number of supported IRQs"
    default 128

endmenu
```

## core/mm/Kconfig
```kconfig
menu "Memory Manager"

config MEM_HEAP_SIZE
    int "OS heap size (bytes)"
    default 16777216 # 16MB

config MEM_HEAP_BUFFER_PROTECTION
    bool "Enable heap buffer protection (affects performance)"
    default y

choice
    prompt "Heap Manager"
    default MM_FREELIST

config MM_FREELIST
    bool "Simple freelist memory manager"

endchoice

choice
    prompt "Slab Manager"
    default MM_BITSET_SLAB

config MM_BITSET_SLAB
    bool "Simple bitset slab allocator"

endchoice

endmenu
```

## core/process/Kconfig
```kconfig
menu "Process"

config PROCESS_MAX_CMD_LEN
    int "Max length for the command line value saved in the pcb"
    default 64

config PROCESS_MAX_NAME_LEN
    int "Max length for the process name"
    default 16

config PROCESS_MAX_CONCURRENT_PROCS
    int "Max number of concurrent processes allowed in the system"
    default 64

config PROCESS_MAX_OPEN_FILES
    int "Max number of open files"
    default 16

config PROCESS_INIT_STACK_SIZE
    int "Init process stack size"
    default 8196

config PROCESS_IDLE_STACK_SIZE
    int "Idle process stack size"
    default 8196

menu "Health monitor"

config PROCESS_HEALTH_CHECK_INTERVAL
    int "Time in seconds between system health checks"
    default 30

config PROCESS_HEALTH_AVAIL_HEAP_WARNING_THRESHOLD
    int "% of available heap at which to trigger a warning"
    default 30

config PROCESS_HEALTH_AVAIL_PROC_STACK_WARNING_THRESHOLD
    int "% of available process stack at which to trigger a warning"
    default 30

endmenu

endmenu
```

## core/sched/Kconfig
```kconfig
menu "Scheduler"

config SCHED_PRIORITY_MAX_KERNEL
    int "Maximum priority for a kernel process"
    default 0

config SCHED_PRIORITY_MAX_USER
    int "Maximum priority for a user process"
    default 64

config SCHED_PRIORITY_LOWEST
    int "Lowest priority"
    default 255

config SCHED_PRIORITY_USER_DEFAULT
    int "Default priority for new user processes"
    default 100

endmenu
```
