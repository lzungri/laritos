## core/syscall/Kconfig
```kconfig
menu "System calls"

config SYSCALL_MAX_ARGS
    int "Max number of arguments allowed for a system call"
    default 6

config SYSCALL_OPEN_BACKDOOR
    bool "Open backdoor syscall for CIA/debugging purposes"
    default y

endmenu
```

## core/timer/Kconfig
```kconfig
menu "Timer"

config TICKER_DEF_FREQ
    int "Default ticker frequency"
    default 100

endmenu
```

## drivers/Kconfig
```kconfig
menu "Drivers"

source "drivers/intc/Kconfig"
source "drivers/uart/Kconfig"
source "drivers/rtc/Kconfig"
source "drivers/cpu/Kconfig"
source "drivers/timer/Kconfig"
source "drivers/logger/Kconfig"
source "drivers/input/Kconfig"

endmenu
```

## drivers/blockdev/Kconfig
```kconfig
menu "Block device"

config BLOCKDEV_FLASH_CFI
    bool "Common Flash Memory Interface"
    default n

endmenu
```

## drivers/intc/Kconfig
```kconfig
menu "Interrupt controller"

config INTC_ARM_GICV2
    bool "ARM generic interrupt controller v2"
    default n

endmenu
```

## drivers/mci/Kconfig
```kconfig
menu "Multimedia Card Interface"
    depends on MCI_SUPPORT

config MCI_PL181
    bool "PL181 Multimedia Card Interface"
    default n

endmenu
```

## drivers/rtc/Kconfig
```kconfig
menu "RTC"

config RTC_ARM_PL031
    bool "ARM PrimeCell RTC (pl031)"
    default n

endmenu
```

## drivers/timer/Kconfig
```kconfig
menu "Timer"

config TIMER_ARM_V7_GENERIC
    bool "ARM v7 generic timer"
    default n

endmenu
```

## drivers/uart/Kconfig
```kconfig
menu "UART"

config UART_RXBUF_SIZE
    int "UART buffer size for holding received data (in bytes)"
    default 512

config UART_TXBUF_SIZE
    int "UART buffer size for holding data to be transmitted (in bytes)"
    default 1024

config UART_ARM_PL011
    bool "ARM PrimeCell UART (pl011)"
    default n

endmenu
```

## test/Kconfig
```kconfig
menu "Testing"

config TEST_ENABLED
    bool "Enable kernel testing"
    default n

config PROCESS_TEST_STACK_SIZE
    int "Test process stack size"
    default 8196

source "test/fwk/Kconfig"
source "test/tests/Kconfig"

endmenu
```

## test/tests/Kconfig
```kconfig
menu "Tests"
    depends on TEST_ENABLED

config TEST_ALL
    bool "Select all"
    default n
    select TEST_CORE_ALL
    select TEST_UTILS_ALL

source "test/tests/core/Kconfig"
source "test/tests/utils/Kconfig"

endmenu
```

## test/tests/core/Kconfig
```kconfig
menu "Core"

config TEST_CORE_ALL
    bool "Select all"
    default n
    select TEST_CORE_LIBC_ALL
    select TEST_CORE_MM_ALL
    select TEST_CORE_DSTRUCT_ALL
    select TEST_CORE_COMPONENT_ALL
    select TEST_CORE_TIME_ALL
    select TEST_CORE_PROCESS_ALL
    select TEST_CORE_SYNC_ALL
    select TEST_CORE_IRQ_ALL

source "test/tests/core/libc/Kconfig"
source "test/tests/core/mm/Kconfig"
source "test/tests/core/dstruct/Kconfig"
source "test/tests/core/component/Kconfig"
source "test/tests/core/time/Kconfig"
source "test/tests/core/process/Kconfig"
source "test/tests/core/sync/Kconfig"
source "test/tests/core/irq/Kconfig"

endmenu
```

## test/tests/core/component/Kconfig
```kconfig
menu "Component"

config TEST_CORE_COMPONENT_ALL
    bool "Select all"
    default n
    select TEST_CORE_COMPONENT_TICKER
    select TEST_CORE_COMPONENT_VRTIMER
    select TEST_CORE_COMPONENT_CPU

config TEST_CORE_COMPONENT_TICKER
    bool "ticker.c"
    default n

config TEST_CORE_COMPONENT_VRTIMER
    bool "vrtimer.c"
    default n

config TEST_CORE_COMPONENT_CPU
    bool "cpu.c"
    default n

endmenu
```

## test/tests/core/dstruct/Kconfig
```kconfig
menu "Data structures"

config TEST_CORE_DSTRUCT_ALL
    bool "Select all"
    default n
    select TEST_CORE_DSTRUCT_BITSET
    select TEST_CORE_DSTRUCT_CIRCBUF

config TEST_CORE_DSTRUCT_BITSET
    bool "bitset.c"
    default n

config TEST_CORE_DSTRUCT_CIRCBUF
    bool "circbuf.c"
    default n

endmenu
```

## test/tests/core/fs/Kconfig
```kconfig
menu "File system"

config TEST_CORE_FS_ALL
    bool "Select all"
    default n
    select TEST_CORE_FS_VFS_ALL
    select TEST_CORE_FS_PSEUDOFS_ALL
    select TEST_CORE_FS_EXT2_ALL

source "test/tests/core/fs/vfs/Kconfig"
source "test/tests/core/fs/pseudofs/Kconfig"
source "test/tests/core/fs/ext2/Kconfig"

endmenu
```

## test/tests/core/fs/ext2/Kconfig
```kconfig
menu "ext2"

config TEST_CORE_FS_EXT2_ALL
    bool "Select all"
    default n
    select TEST_CORE_FS_EXT2_CORE

config TEST_CORE_FS_EXT2_CORE
    bool "core.c"
    default n

endmenu
```

## test/tests/core/fs/pseudofs/Kconfig
```kconfig
menu "Pseudofs"

config TEST_CORE_FS_PSEUDOFS_ALL
    bool "Select all"
    default n
    select TEST_CORE_FS_PSEUDOFS_CORE
    select TEST_CORE_FS_PSEUDOFS_FILE

config TEST_CORE_FS_PSEUDOFS_CORE
    bool "core.c"
    default n

config TEST_CORE_FS_PSEUDOFS_FILE
    bool "file.c"
    default n

endmenu
```

## test/tests/core/fs/vfs/Kconfig
```kconfig
menu "VFS"

config TEST_CORE_FS_VFS_ALL
    bool "Select all"
    default n
    select TEST_CORE_FS_VFS_CORE

config TEST_CORE_FS_VFS_CORE
    bool "core.c"
    default n

config TEST_CORE_FS_VFS_MOUNT
    bool "mount.c"
    default n

endmenu
```

## test/tests/core/irq/Kconfig
```kconfig
menu "IRQ"

config TEST_CORE_IRQ_ALL
    bool "Select all"
    default n
    select TEST_CORE_IRQ

config TEST_CORE_IRQ
    bool "irq.c"
    default n

endmenu
```
